## board/contest_board/Kconfig
```kconfig
#
# Contest 2026 team 393 - AI-VOX3 board (ESP32-S3-R8)
#

if ARCH_BOARD_CONTEST2026_393_BOARD

config ARCH_BOARD_CONTEST2026_393_BOARD_TAG
	string "Board tag"
	default "contest2026_393_board"

# --- Onboard peripherals (each can be enabled independently) ---

config AIVOX3_LCD
	bool "Enable AI-VOX3 ST7789 LCD (SPI)"
	default y
	select ESP32S3_SPI2
	select SPI
	select SPI_CMDDATA
	select SPI_EXCHANGE
	select LCD
	select LCD_DEV
	select LCD_ST7789
	select LCD_FRAMEBUFFER
	---help---
		AI-VOX3 1.54" ST7789 LCD on the ESP32-S3 FSPI (SPI2) bus.

config AIVOX3_BUTTONS
	bool "Enable AI-VOX3 onboard buttons"
	default y
	select INPUT_BUTTONS
	---help---
		Three user buttons (GPIO46/45/0, active low).

config AIVOX3_SERVO
	bool "Enable AI-VOX3 pan/tilt servo (LEDC PWM)"
	default y
	select ESP32S3_LEDC
	---help---
		Two servos on GPIO42 (PAN) and GPIO43 (TILT) driven by LEDC.

config AIVOX3_ES8311
	bool "Enable AI-VOX3 ES8311 audio codec (I2C)"
	default y
	select ESP32S3_I2C0
	select I2C
	select I2C_DRIVER
	---help---
		ES8311 codec on I2C (SCL=12, SDA=13, ADDR=0x18). I2C bus is
		auto-registered by the arch driver; this just documents the pin map.

config AIVOX3_WS2812
	bool "Enable AI-VOX3 WS2812 RGB (M2 - stub)"
	default n
	---help---
		WS2811/WS2812 single-wire RGB on GPIO41. Needs a bit-bang / RMT
		lower half (not in base tree); deferred to M2.

config AIVOX3_SDMMC
	bool "Enable AI-VOX3 microSD (M2 - stub)"
	default n
	---help---
		microSD on SDMMC (CMD=38, CLK=39, DAT0=40). Deferred to M2.

endif
```

## board/contest_board/configs/openvela/defconfig
```kconfig
# Contest 2026 team 393 - AI-VOX3 desktop companion (full config)
# Console over native USB-CDC (VID:PID 303A:1001).
# Reference: vendor_espressif/boards/esp32s3/esp32s3-eye

CONFIG_ARCH="xtensa"
CONFIG_ARCH_XTENSA=y
CONFIG_ARCH_BOARD_COMMON=y
CONFIG_ARCH_BOARD_CONTEST2026_393_BOARD=y
CONFIG_ARCH_CHIP="esp32s3"
CONFIG_ARCH_CHIP_ESP32S3=y
CONFIG_ARCH_INTERRUPTSTACK=2048
CONFIG_BOARD_LOOPSPERMSEC=16717

# Dual core + 8 MB OCT PSRAM
CONFIG_SMP=y
CONFIG_SMP_NCPUS=2
CONFIG_ESP32S3_SPIRAM=y
CONFIG_ESP32S3_SPIRAM_MODE_OCT=y

# Native USB-CDC serial console
CONFIG_ESP32S3_USBSERIAL=y
CONFIG_USBSERIAL_CONSOLE=y

# Internal SRAM (PSRAM is heap-extended by the SPIRAM driver)
CONFIG_RAM_START=0x20000000
CONFIG_RAM_SIZE=114688

# ---- SPI2 (FSPI) for LCD ----
CONFIG_ESP32S3_SPI2=y
CONFIG_ESP32S3_SPI2_MOSI_GPIO=21
CONFIG_ESP32S3_SPI2_MISO_GPIO=4
CONFIG_ESP32S3_SPI2_CLK_GPIO=17
CONFIG_ESP32S3_SPI2_CS0_GPIO=15

# ---- LCD ST7789 (240x240, RGB565) ----
CONFIG_LCD=y
CONFIG_LCD_DEV=y
CONFIG_LCD_ST7789=y
CONFIG_LCD_ST7789_XRES=240
CONFIG_LCD_ST7789_YRES=240
CONFIG_LCD_ST7789_BPP=16
CONFIG_LCD_ST7789_FREQUENCY=20000000
CONFIG_LCD_ST7789_INVCOLOR=y
CONFIG_LCD_FRAMEBUFFER=y

# ---- Buttons ----
CONFIG_INPUT_BUTTONS=y

# ---- Servo PWM (LEDC) ----
CONFIG_ESP32S3_LEDC=y
CONFIG_ESP32S3_LEDC_TIMER0=y
CONFIG_ESP32S3_LEDC_CHANNEL0=y
CONFIG_ESP32S3_LEDC_CHANNEL0_GPIO=42
CONFIG_ESP32S3_LEDC_CHANNEL0_TIMER=0
CONFIG_ESP32S3_LEDC_TIMER1=y
CONFIG_ESP32S3_LEDC_CHANNEL1=y
CONFIG_ESP32S3_LEDC_CHANNEL1_GPIO=43
CONFIG_ESP32S3_LEDC_CHANNEL1_TIMER=1

# ---- I2C for ES8311 ----
CONFIG_ESP32S3_I2C0=y
CONFIG_I2C=y
CONFIG_I2C_DRIVER=y

# ---- NSH + builtin app ----
CONFIG_SYSTEM_NSH=y
CONFIG_INIT_ENTRYPOINT="nsh_main"
CONFIG_NSH_ARCHINIT=y
CONFIG_NSH_BUILTIN_APPS=y
CONFIG_NSH_READLINE=y
CONFIG_LVX_USE_DEMO_CONTEST2026_393_DESKTOP_COMPANION=y

# Scheduling / runtime
CONFIG_RR_INTERVAL=200
CONFIG_SCHED_WAITPID=y
CONFIG_PREALLOC_TIMERS=4
CONFIG_IDLETHREAD_STACKSIZE=3072
CONFIG_INIT_STACKSIZE=3072
CONFIG_DEFAULT_TASK_STACKSIZE=4096

# Debug / diagnostics
CONFIG_DEBUG_SYMBOLS=y
CONFIG_ARCH_STACKDUMP=y
CONFIG_INTELHEX_BINARY=y
CONFIG_RAW_BINARY=y
```

## staging/apps/examples/desktop_companion/Kconfig
```kconfig
#
# apps/examples/desktop_companion/Kconfig
#
# Kconfig for the AI-VOX3 desktop companion example application.
#
# NOTE: To be picked up by the build, this file must be sourced from
# apps/examples/Kconfig (add:  source "examples/desktop_companion/Kconfig").
# See staging/README.md for the exact integration steps.
#

config EXAMPLES_DESKTOP_COMPANION
  tristate "Desktop Companion (AI-VOX3) example"
  default n
  ---help---
    AI-VOX3 desktop companion application: 5 facial expressions, time/weather/
    todo desktop cards, a text->LLM(mimo-v2.5-pro)->echo loop, a servo-based
    face-follow demo (no camera), and a smart-home intent stub.

  if EXAMPLES_DESKTOP_COMPANION

  config AIVOX3_LLM_API_KEY
    string "LLM API key (injected at build; NEVER commit plaintext)"
    default ""
    ---help---
      API key for the mimo-v2.6-pro endpoint. Leave empty to inject it at
      runtime via NVS. The source tree MUST NOT contain the real secret;
      prefer menuconfig or an NVS-stored value.

  config AIVOX3_LLM_MODEL
    string "LLM model name"
    default "mimo-v2.6-pro"

  config AIVOX3_WIFI_SSID
    string "Wi-Fi SSID (station mode)"
    default ""
    ---help---
      SSID of the AP the board associates with at boot. net_init() reads it
      when net_wifi_connect() is called with a NULL/empty ssid, which is
      what main.c does.

      Leave it empty only if the network is joined some other way (e.g. the
      esp32s3 saved-parameter auto-join); with an empty value net_init()
      fails fast with -EINVAL and says so in the syslog instead of hanging.

  config AIVOX3_WIFI_PASSWORD
    string "Wi-Fi WPA2 passphrase (build-config only; NEVER commit plaintext)"
    default ""
    ---help---
      WPA2-PSK passphrase for the SSID above. Like AIVOX3_LLM_API_KEY this is
      a build-time symbol: set it with menuconfig or inject it at build time,
      and never hard-code it in a .c/.h file. The source tree carries only the
      empty default.

      net_services.c logs the SSID and the fact that a passphrase is set, but
      NEVER the passphrase itself.

  config AIVOX3_BRIDGE_HOST
    string "PC voice bridge host (IP of the machine running bridge_chat.py)"
    default "192.168.1.23"
    ---help---
      The board has no ASR and no TTS, so a spoken turn is relayed to a PC
      running toolchain/voice_bridge/bridge_chat.py (Vosk ASR + mimo LLM +
      edge-tts), which listens on 0.0.0.0:8765.

      THIS ADDRESS WILL GO STALE: home routers hand out DHCP leases, so the
      PC moves. Set the value that is correct for your LAN here, and use the
      console command below after flashing when it changes:

          bridge 192.168.1.42        (same port)
          bridge 192.168.1.42 9000   (host + port)

      Typing "bridge" alone on the USB-CDC console prints the endpoint
      currently in use. The runtime override is RAM-only (lost on reboot).

  config AIVOX3_BRIDGE_PORT
    int "PC voice bridge TCP port"
    default 8765
    range 1 65535

  config AIVOX3_BRIDGE_TIMEOUT
    int "PC voice bridge timeout (seconds of socket inactivity)"
    default 60
    range 10 300
    ---help---
      One turn costs Vosk/mimo ASR (1-4 s) + streaming LLM (3-10 s) +
      per-sentence TTS (2-6 s). This is an INACTIVITY timeout restarted by
      every received burst, not an overall deadline, so 60 s is a safe
      default that only fires on a genuinely dead bridge.

  config SMART_HOME_BACKEND
    string "Smart-home backend (none/mqtt/http)"
    default "none"
    ---help---
      Selects the smart-home backend. The default "none" makes
      smart_home_control() parse intent and return "unconfigured".

  config AIVOX3_KWS_STORE_PATH
    string "Offline wake-word template storage path"
    default "/mnt/sd0/wake.bin"
    ---help---
      POSIX path used by kws_save()/kws_load() to persist the DTW template
      bank. It MUST point into a writable, mounted filesystem (FAT on the
      SD card or on a SPI-flash partition). This board config currently
      enables no writable filesystem, so kws_save() will report -ENOENT
      until one is mounted; templates then live in RAM only.

  config AIVOX3_KWS_THRESHOLD
    int "Default DTW decision threshold (0 = wait for calibration)"
    default 2400
    ---help---
      Normalized DTW distance below which an utterance is accepted. 2400 is
      the value measured on the Arduino reference firmware after recording
      "ni hao, openvela" three times; it transfers directly because the
      front-end geometry, feature scaling and distance metric are identical.
      Set 0 to require kws_learn() to calibrate a threshold first.

  config AIVOX3_READ_ENABLED
    bool "Audiobook (novel reading) mode"
    default y
    ---help---
      Adds the "read the novel" feature: load a novel text from FFat, send each
      segment to the PC bridge /tts endpoint and play the returned PCM through
      the existing chat TTS path. Trigger via the serial 'read' command, an
      LVGL "READ" button, or 'pause'/'resume'/'next'/'prev'/'stop' to control
      playback.

  config AIVOX3_READ_NOVEL_PATH
    string "Novel file path on FFat"
    default "/mnt/ffat/novel.txt"
    depends on AIVOX3_READ_ENABLED
    ---help---
      POSIX path the reader opens for the novel text (and writes the built-in
      sample to on first boot). Must resolve inside a mounted, writable FFat.

  config AIVOX3_READ_NOVEL_MAX_BYTES
    int "Max novel size loaded into RAM (bytes)"
    default 262144
    range 8192 4194304
    depends on AIVOX3_READ_ENABLED
    ---help---
      Upper bound on the novel bytes loaded into RAM. The reading feature is
      intended for short stories / chapters; the bridge /upload_novel enforces
      the same ceiling on the PC side.

  endif
```

## staging/vendor_espressif/boards/esp32s3/ai_vox3/Kconfig
```kconfig
#
# Kconfig — Board configuration for emakefun AI-VOX3 (ESP32-S3-R8)
#
# Follows the OpenVela vendor-board convention (see esp32s3-eye):
# board options are wrapped in `if ARCH_BOARD_CUSTOM` because vendor
# boards are selected via ARCH_BOARD_CUSTOM + ARCH_BOARD_CUSTOM_DIR.
#
# Pin defaults mirror board.h / the porting plan appendix B. These can
# be overridden in menuconfig.
#

if ARCH_BOARD_CUSTOM

menu "AI-VOX3 Board Settings"

comment "All default pin values are sourced from the AI-VOX3 knowledge base."

config AI_VOX3_SERVO
	bool "Enable servo (LEDC PWM) support"
	default n
	---help---
		Requires CONFIG_ESP32S3_LEDC to be enabled in the defconfig.

config AI_VOX3_WS2812
	bool "Enable WS2812 RGB LED (RMT) support"
	default n
	---help---
		Requires CONFIG_ESP32S3_RMT to be enabled in the defconfig.

config AI_VOX3_BUTTONS
	bool "Enable on-board buttons (input GPIO) support"
	depends on ESP32S3_GPIO_IRQ
	default n
	---help---
		Requires CONFIG_ESP32S3_GPIO_IRQ to be enabled in the defconfig.
		(The buttons driver attaches its own GPIO ISRs via ESP32S3_PIN2IRQ
		and does not use the generic INPUT_BUTTONS framework.)

config AI_VOX3_LCD_MOSI
	int "LCD MOSI (FSPI data) GPIO"
	default 21

config AI_VOX3_LCD_SCL
	int "LCD SCL (FSPI clock) GPIO"
	default 17

config AI_VOX3_LCD_DC
	int "LCD DC GPIO"
	default 14

config AI_VOX3_LCD_CS
	int "LCD CS GPIO"
	default 15

config AI_VOX3_LCD_BL
	int "LCD backlight GPIO"
	default 16

config AI_VOX3_LCD_RST
	int "LCD reset GPIO (-1 if not connected)"
	default -1

config AI_VOX3_ES8311_I2C_SCL
	int "ES8311 I2C SCL GPIO"
	default 12

config AI_VOX3_ES8311_I2C_SDA
	int "ES8311 I2C SDA GPIO"
	default 13

config AI_VOX3_ES8311_I2C_ADDR
	int "ES8311 I2C address"
	default 24

config AI_VOX3_I2S_MCLK
	int "I2S MCLK GPIO"
	default 11

config AI_VOX3_I2S_BCLK
	int "I2S BCLK GPIO"
	default 10

config AI_VOX3_I2S_WS
	int "I2S WS/LRCK GPIO"
	default 9

config AI_VOX3_I2S_DOUT
	int "I2S DOUT/ASDOUT GPIO"
	default 8

config AI_VOX3_I2S_DIN
	int "I2S DIN/DSDIN GPIO"
	default 7

config AI_VOX3_SERVO0_GPIO
	int "Servo 0 (PAN/TILT) GPIO"
	default 42

config AI_VOX3_SERVO1_GPIO
	int "Servo 1 GPIO"
	default 43

config AI_VOX3_SERVO2_GPIO
	int "Servo 2 GPIO"
	default 44

config AI_VOX3_SERVO3_GPIO
	int "Servo 3 GPIO"
	default 48

config AI_VOX3_WS2812_GPIO
	int "WS2812 RGB LED GPIO"
	default 41

config AI_VOX3_SD_CMD_GPIO
	int "SD CMD GPIO"
	default 38

config AI_VOX3_SD_CLK_GPIO
	int "SD CLK GPIO"
	default 39

config AI_VOX3_SD_DAT0_GPIO
	int "SD DAT0 GPIO"
	default 40

config AI_VOX3_BTN_A_GPIO
	int "Button A GPIO"
	default 46

config AI_VOX3_BTN_B_GPIO
	int "Button B GPIO"
	default 45

config AI_VOX3_BTN_BOOT_GPIO
	int "Button BOOT GPIO"
	default 0

config AI_VOX3_BAT_ADC_GPIO
	int "Battery ADC GPIO"
	default 18

endmenu

endif # ARCH_BOARD_CUSTOM
```

## staging/vendor_espressif/boards/esp32s3/ai_vox3/configs/wifi/defconfig
```kconfig
# =============================================================================
# AI-VOX3 (emakefun) — Config: wifi
# nsh + ESP32-S3 Wi-Fi + TCP/IP stack + DHCP/DNS/NTP helpers
# Board: ESP32-S3-R8, 16MB Flash, 8MB OPI PSRAM
# =============================================================================

CONFIG_ARCH="xtensa"
CONFIG_ARCH_CHIP="esp32s3"
CONFIG_ARCH_CHIP_ESP32S3=y
CONFIG_ARCH_CHIP_ESP32S3WROOM1N16R8=y

CONFIG_ARCH_BOARD="ai_vox3"
CONFIG_ARCH_BOARD_AI_VOX3=y

CONFIG_ESP32S3_DEFAULT_CPU_FREQ_240=y
CONFIG_ESP32S3_FLASH_16M=y
CONFIG_ESP32S3_SPIRAM=y
CONFIG_ESP32S3_SPIRAM_MODE_OCT=y
CONFIG_ESP32S3_SPIRAM_SPEED_80M=y

# --- Console: native USB-CDC -------------------------------------------------
CONFIG_ESP32S3_USBSERIAL=y
CONFIG_ESP32S3_CDCACM=y
CONFIG_CDCACM=y
CONFIG_CDCACM_CONSOLE=y
CONFIG_UART0_SERIAL_CONSOLE=n
# TODO(real-device): verify USB-CDC console on the real board.

# --- Wi-Fi + network stack ---------------------------------------------------
CONFIG_ESP32S3_WIFI=y
CONFIG_ESP32S3_WIFI_SAVE_PARAM=y
CONFIG_ESP32S3_WIFI_STATION=y

CONFIG_NET=y
CONFIG_NETDEVICES=y
CONFIG_NET_IPv4=y
CONFIG_NET_ICMP=y
CONFIG_NET_ICMP_SOCKET=y
CONFIG_NET_ARP=y
CONFIG_NET_TCP=y
CONFIG_NET_UDP=y
CONFIG_NET_SOCKOPTS=y
CONFIG_NETDB_DNS=y
CONFIG_NETDB_DNSCLIENT=y
CONFIG_NETUTILS_DHCPC=y
CONFIG_NETUTILS_DNS=y
CONFIG_NETUTILS_NTPCLIENT=y
CONFIG_WIRELESS_WAPI=y
CONFIG_SYSTEM_WPA_NAMES=y

# NSH network init helper (brings up wlan0 via wapi)
CONFIG_NSH_NETINIT=y
CONFIG_NSH_NETINIT_WAPI=y

# --- NSH base ----------------------------------------------------------------
CONFIG_BOARDCTL=y
CONFIG_BUILTIN=y
CONFIG_FS_PROCFS=y
CONFIG_FS_PROCFS_REGISTER=y
CONFIG_INIT_ENTRYPOINT="nsh_main"
CONFIG_NSH_ARCHINIT=y
CONFIG_NSH_BUILTIN_APPS=y
CONFIG_NSH_FILE_APPS=y
CONFIG_NSH_READLINE=y
CONFIG_NSH_ROMFSETC=y
CONFIG_NSH_ROMFSRC=y
CONFIG_NSH_SCRIPT=y
CONFIG_SYSTEM_NSH=y
CONFIG_EXAMPLES_NSH=y

CONFIG_SCHED_WAITPID=y
CONFIG_RR_INTERVAL=200

CONFIG_START_YEAR=2026
CONFIG_START_MONTH=1
CONFIG_START_DAY=1
```
